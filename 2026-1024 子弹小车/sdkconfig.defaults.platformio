## 2026-1024 子弹小车/sdkconfig.defaults.platformio
```kconfig
# 选择现有 ESP32-S3 面包板板型，与其 config.json 中的 128x32 变体一致。
CONFIG_BOARD_TYPE_BREAD_COMPACT_WIFI=y
CONFIG_OLED_SSD1306_128X32=y

# 小车语音联调：麦克风沿用板型接线，启用用户确认的 STM32 UART1。
CONFIG_CAR_CONTROL=y
CONFIG_CAR_AUTO_LISTEN=y
CONFIG_CAR_REPLY_AUDIO=n
CONFIG_CAR_UART_PORT=1
CONFIG_CAR_UART_TX_GPIO=17
CONFIG_CAR_UART_RX_GPIO=21
CONFIG_CAR_LED_GPIO=-1
CONFIG_WIFI_ACTIVATION_PORTAL=y

# 关闭纯文字测试，恢复麦克风上传、自动监听及小车 UART 动作输出。
# CONFIG_SERIAL_TEXT_CHAT is not set
```
